// To get started, press Ctrl+Space to bring up the completion menu and view the available nodes.
// For more help, browse the DeviceTree documentation at https://docs.zephyrproject.org/latest/guides/dts/index.html

&i2c2 {
    
    mysensor: mysensor@76{
        compatible = "bosch,bme680";
        status = "okay";
        reg = < 0x76 >;
    };
};
